## drivers/input/touchscreen/oplus_touchscreen/Synaptics/Syna_tcm_oncell/Kconfig
```kconfig
#
# Synaptics TCM touchscreen driver configuration
#
config TOUCHPANEL_SYNAPTICS_TCM_ONCELL
	bool "Synaptics TCM touchscreen"
	default n
	help
	  Say Y here if you have a Synaptics TCM touchscreen connected
	  to your system.

	  If unsure, say N.

config TOUCHPANEL_SYNAPTICS_TCM_ONCELL_EXPERIMENTAL_EE013023
	bool "Allow experimental EE013023 image test on EE013A1F"
	depends on TOUCHPANEL_SYNAPTICS_TCM_ONCELL
	default n
	help
	  Expose the bundled EE013023 Samsung S3908 firmware image to an
	  EE013A1F controller for controlled compatibility testing.

	  A normal firmware check only parses and logs the candidate image.
	  The driver requires an explicit forced firmware update before it
	  permits the cross-revision write.

	  This can leave the touchscreen unusable and should remain disabled
	  in production kernels.
```

## drivers/interconnect/Kconfig
```kconfig
menu "Interconnect drivers"

config INTERCONNECT
bool "Interconnect support"
help
  Say Y here to enable the generic interconnect framework used to
  describe and manage bandwidth requirements between on-chip masters
  and slaves. Individual provider drivers are required for each bus
  topology. If unsure, say N.

if INTERCONNECT

source "drivers/interconnect/qcom/Kconfig"

endif # INTERCONNECT

endmenu
```

## drivers/interconnect/qcom/Kconfig
```kconfig
menu "Qualcomm interconnect drivers"

config INTERCONNECT_QCOM
bool "Qualcomm interconnect support"
depends on INTERCONNECT
select QCOM_RPMH
select QCOM_COMMAND_DB
help
  Enable support for Qualcomm Technologies, Inc. interconnect providers.
  Individual SoC drivers need to be enabled as well.

config INTERCONNECT_QCOM_KONA
bool "Qualcomm Kona interconnect"
depends on INTERCONNECT_QCOM
help
  Enable the virtual interconnect provider used on SM8250/Kona based
  platforms. This driver allows clients to express bandwidth requests
  through the common interconnect framework. The validated SH4, SH0 and MC0
  CPU BCM path can be selected for A/B testing with the built-in kernel
  boot-only command line option kona.rpmh_model. Stage 1 discovers metadata,
  stages 2 and 3 validate ownership while retaining legacy programming, and
  stage 4 enables the CPU transaction only after all three BCMs are valid.
  The deprecated kona.rpmh_cpu_model=1 spelling maps to safe stage 1.

config INTERCONNECT_QCOM_KONA_PERF_FLOOR
bool "Enable Kona interconnect performance floors"
depends on INTERCONNECT_QCOM_KONA
default y
help
  Apply workload-aware bandwidth floors to Kona interconnect paths. The
  policy keeps light clients at low average-bandwidth votes while preserving
  high instantaneous DDR and LLCC peak-bandwidth headroom for CPU, GPU,
  media, storage, and accelerator bursts. Auxiliary CPU_MEM/CPU_LLCC-backed
  clients receive bounded baselines instead of CPU-sized floors. Disable only
  if you have an alternate mechanism for managing bandwidth votes.

config INTERCONNECT_QCOM_KONA_DEBUG
bool "Verbose Kona interconnect logging"
depends on INTERCONNECT_QCOM_KONA
help
  Emit detailed bandwidth vote messages from the Kona interconnect driver
  to aid in debugging bandwidth scaling decisions.

endmenu
```
